## CMakeLists.txt
```
cmake_minimum_required(VERSION 3.20.0)

find_package(Zephyr REQUIRED HINTS $ENV{ZEPHYR_BASE})
project(padmapper)

target_sources(app PRIVATE src/main.c src/pad.c src/out.c src/engine.c src/cfg.c src/ble_out.c src/ble_cfg.c src/pm_hmac.c src/hid_in.c src/hid_map.c)
if(CONFIG_USB_MASS_STORAGE)
  target_sources(app PRIVATE src/vdisk.c)
endif()

# Kartın USB belleğine gömülen ayar sayfası (derleme sırasında assets/ içine konur)
if(CONFIG_USB_MASS_STORAGE)
  set(ASSETS ${CMAKE_CURRENT_SOURCE_DIR}/assets)
  if(NOT EXISTS ${ASSETS}/padmapper.html)
    file(WRITE ${ASSETS}/padmapper.html "")
  endif()
  set(gen_dir ${ZEPHYR_BINARY_DIR}/include/generated)
  generate_inc_file_for_target(app ${ASSETS}/padmapper.html ${gen_dir}/html.inc)
endif()
```

## prj.conf
```kconfig
# PadMapper – adım 1: Bluetooth kontrolcüyü bul, bağlan, tuş haritasını ve basışları USB seri porta yaz.
# Adım 2: tablete USB gamepad + klavye + fare çıkışı da var.

# --- Bluetooth (merkez cihaz) ---
CONFIG_BT=y
CONFIG_BT_CENTRAL=y
CONFIG_BT_SMP=y
CONFIG_BT_GATT_CLIENT=y
CONFIG_BT_GATT_DM=y
CONFIG_BT_SCAN=y
CONFIG_BT_SCAN_FILTER_ENABLE=y
CONFIG_BT_SCAN_UUID_CNT=1
CONFIG_BT_SCAN_ADDRESS_CNT=7
CONFIG_BT_HOGP=y
# pad + 2 klavye/fare raporları (ortak havuz)
CONFIG_BT_HOGP_REPORTS_MAX=32
CONFIG_BT_MAX_CONN=5
# 2 çevre: hedef cihaz + ayar telefonu; kalan 3 merkez: pad (+ ileride Bluetooth klavye/fare)
CONFIG_BT_CTLR_SDC_PERIPHERAL_COUNT=2
CONFIG_BT_ID_MAX=2
CONFIG_BT_MAX_PAIRED=8
CONFIG_BT_DEVICE_NAME="pmape.github.io"
CONFIG_BT_DEVICE_NAME_DYNAMIC=y
CONFIG_BT_DEVICE_NAME_MAX=30

# Eşleşmeleri hatırla
CONFIG_BT_SETTINGS=y
CONFIG_SETTINGS=y
CONFIG_FLASH=y
CONFIG_FLASH_MAP=y
CONFIG_NVS=y

# --- USB seri port (ayar ekranı ve test için) ---
CONFIG_USB_DEVICE_STACK=y
CONFIG_USB_DEVICE_PRODUCT="PadMapper"
CONFIG_USB_DEVICE_MANUFACTURER="PadMapper"
CONFIG_SERIAL=y
CONFIG_CONSOLE=y
CONFIG_UART_CONSOLE=y
CONFIG_UART_LINE_CTRL=y

# --- Genel ---
CONFIG_HEAP_MEM_POOL_SIZE=8192
CONFIG_MAIN_STACK_SIZE=2048
CONFIG_SYSTEM_WORKQUEUE_STACK_SIZE=3072
CONFIG_BUILD_OUTPUT_UF2=y

# --- Adım 2: tablete USB klavye + fare + gamepad ---
CONFIG_USB_DEVICE_HID=y
CONFIG_USB_HID_DEVICE_COUNT=4
CONFIG_USB_COMPOSITE_DEVICE=y
CONFIG_USB_HID_POLL_INTERVAL_MS=1
CONFIG_GPIO=y
CONFIG_USB_DEVICE_INITIALIZE_AT_BOOT=n
CONFIG_USB_DEVICE_REMOTE_WAKEUP=y
CONFIG_USB_CDC_ACM_RINGBUF_SIZE=2048
CONFIG_USB_DEVICE_VID=0x2FE3
CONFIG_USB_DEVICE_PID=0x0100
# Kartın USB belleği: tablette sorun çıkardığı için kapalı (0.5.1)

# --- Bluetooth çıkış: kart hedef cihaza klavye + fare + gamepad olarak bağlanır ---
CONFIG_BT_PERIPHERAL=y
CONFIG_BT_HIDS=y
CONFIG_BT_HIDS_MAX_CLIENT_COUNT=3
CONFIG_BT_HIDS_INPUT_REP_MAX=4
CONFIG_BT_HIDS_DEFAULT_PERM_RW_ENCRYPT=y
CONFIG_BT_CONN_CTX=y
CONFIG_BT_GATT_UUID16_POOL_SIZE=40
CONFIG_BT_GATT_CHRC_POOL_SIZE=20
CONFIG_BT_SMP_APP_PAIRING_ACCEPT=y
CONFIG_BT_DEVICE_APPEARANCE=964
CONFIG_BT_BUF_ACL_TX_COUNT=10

# --- Gecikme ---
# 2M PHY isteği
CONFIG_BT_USER_PHY_UPDATE=y
# pad ve hedef bağlantısı aynı anda 7,5 ms aralığa sığsın
CONFIG_BT_CTLR_SDC_MAX_CONN_EVENT_LEN_DEFAULT=2500
CONFIG_REBOOT=y

# --- Telefondan kablosuz ayar ---
CONFIG_BT_RX_STACK_SIZE=3072
CONFIG_BT_L2CAP_TX_MTU=247
CONFIG_BT_BUF_ACL_RX_SIZE=251
CONFIG_BT_BUF_ACL_TX_SIZE=251
CONFIG_BT_CTLR_DATA_LENGTH_MAX=251
CONFIG_BT_GATT_SERVICE_CHANGED=y

# iki yayın aynı anda (oyun + ayar)
CONFIG_BT_EXT_ADV=y
CONFIG_BT_EXT_ADV_MAX_ADV_SET=2
CONFIG_BT_CTLR_ADV_EXT=y
CONFIG_BT_CTLR_ADV_SET=2
```

## msc.conf
```kconfig
# Kartın USB belleği: ayar sayfası (AYAR.HTM) ve indirme bağlantıları, salt okunur
CONFIG_DISK_ACCESS=y
CONFIG_USB_MASS_STORAGE=y
CONFIG_MASS_STORAGE_DISK_NAME="PM"
CONFIG_MASS_STORAGE_INQ_VENDOR_ID="PadMap  "
CONFIG_MASS_STORAGE_INQ_PRODUCT_ID="PadMapper       "
```

## src/ble_cfg.c
```c
/*
 * Telefondan kablosuz ayar.
 *
 *  - Kart, kendi servisini (PM_CFG_UUID) yayınlar. Hedef cihazlar için kullanılan kimlik yerine
 *    ikinci bir kimlikle (PM_CFG_ID) yayın yapar; böylece eşleşmiş PC/TV kendiliğinden bağlanmaz.
 *  - Yayın şu durumda açılır: kartta en az bir telefon anahtarı var, doğrulanmış telefon bağlı değil
 *    ve USB'den 5 sn'dir hiçbir uygulama dinlemiyor (USB'den ayar yapılıyorsa USB'den devam).
 *  - Telefon "nonce" yazar → kart rastgele sayı gönderir → telefon HMAC-SHA256(anahtar, sayı) ile
 *    "auth <hex>" yazar. Doğru değilse bağlantı kesilir. Anahtar kartta en fazla 4 tane saklanır ve
 *    sadece USB'den eklenebilir (uygulama USB'ye bağlanınca kendi anahtarını ekler).
 *  - Doğrulandıktan sonra USB seri porttaki komutların aynısı (dfu ve secret hariç) çalışır, OUT
 *    çıktıları telefona bildirim olarak gider.
 */
#include <string.h>
#include <stdio.h>
#include <zephyr/kernel.h>
#include <zephyr/sys/ring_buffer.h>
#include <zephyr/bluetooth/bluetooth.h>
#include <zephyr/bluetooth/gatt.h>
#include <zephyr/bluetooth/crypto.h>
#include <zephyr/settings/settings.h>
#include "log.h"
#include "ble_cfg.h"
#include "ble_out.h"
#include "pm_hmac.h"

#define NKEY 4
static uint8_t keys[NKEY][32];
static uint8_t nkey;

static struct bt_conn *cc;      /* ayar istemcisi (doğrulanmamış da olabilir) */
static volatile bool authed;
static char nonce[33];
static int64_t last_usb;        /* USB'den en son dinlenen an */
static bool want;
static int64_t open_until;      /* tanıtma penceresi (yeni telefon anahtarını kablosuz bırakabilir) */

/* kapı: kayıtlı cihaz yoksa hep açık; varsa kart güce takıldıktan sonraki ilk 60 sn
 * (ya da kayıtlı bir cihazdan "Yeni cihaz ekle" denince 60 sn) yeni cihaz kendini tanıtabilir */
static bool open_now(void)
{
	int64_t n = k_uptime_get();

	return nkey == 0 || n < 60000 || n < open_until;
}
void ble_cfg_open_window(void)
{
	open_until = k_uptime_get() + 60000;
	OUT("{\"ev\":\"pairwin\",\"s\":60}\n");
	ble_out_adv_kick();
}

extern bool usb_listening(void);

/* ---------- saklama ---------- */

static int k_set(const char *key, size_t len, settings_read_cb rd, void *arg)
{
	if (!strcmp(key, "keys")) {
		uint8_t b[1 + sizeof(keys)];
		ssize_t n = rd(arg, b, sizeof(b));

		if (n >= 1 && b[0] <= NKEY && n >= 1 + b[0] * 32) {
			nkey = b[0];
			memcpy(keys, b + 1, nkey * 32);
		}
		return 0;
	}
	return -ENOENT;
}
SETTINGS_STATIC_HANDLER_DEFINE(pmk, "pmk", NULL, k_set, NULL, NULL);

static void keys_save(void)
{
	uint8_t b[1 + sizeof(keys)];

	b[0] = nkey;
	memcpy(b + 1, keys, nkey * 32);
	settings_save_one("pmk/keys", b, 1 + nkey * 32);
}

/* ---------- gönderim (halka tampon → bildirim) ---------- */

RING_BUF_DECLARE(txr, 4096);
static struct k_spinlock txl;
static K_SEM_DEFINE(tx_sem, 0, 1);
extern const k_tid_t cfg_rx;

static bool tx_put(const char *s, size_t n, bool wait)
{
	for (int tries = 0; ; tries++) {
		k_spinlock_key_t k = k_spin_lock(&txl);
		bool ok = ring_buf_space_get(&txr) >= n;

		if (ok) ring_buf_put(&txr, (const uint8_t *)s, n);
		k_spin_unlock(&txl, k);
		if (ok) { k_sem_give(&tx_sem); return true; }
		if (!wait || !cc || tries > 1500) return false;
		k_sem_give(&tx_sem);
		k_sleep(K_MSEC(2));
	}
}

static void tx_reset(void)
{
	k_spinlock_key_t k = k_spin_lock(&txl);

	ring_buf_reset(&txr);
	k_spin_unlock(&txl, k);
}

void ble_cfg_vout(const char *fmt, va_list ap)
{
	char buf[200];
	va_list a2;

	if (!authed || !cc || k_is_in_isr()) return;
	va_copy(a2, ap);
	int n = vsnprintk(buf, sizeof(buf), fmt, a2);

	va_end(a2);
	if (n <= 0) return;
	/* büyük çıktıları (profil okuma) sadece ayar iş parçacığı bekleyerek yazar */
	bool wait = k_current_get() == cfg_rx;

	if (n < (int)sizeof(buf)) {
		tx_put(buf, n, wait);
		return;
	}
	char *big = k_malloc(n + 1);

	if (!big) return;
	vsnprintk(big, n + 1, fmt, ap);
	tx_put(big, n, wait);
	k_free(big);
}

static void reply(const char *s) { tx_put(s, strlen(s), false); }

/* ---------- GATT ---------- */

static struct bt_uuid_128 svc_uuid = BT_UUID_INIT_128(PM_CFG_UUID_BYTES);
static struct bt_uuid_128 rx_uuid = BT_UUID_INIT_128(BT_UUID_128_ENCODE(0x7a1e0002, 0x3c4b, 0x4a8e, 0x9c1d, 0x50ad2840f00d));
static struct bt_uuid_128 tx_uuid = BT_UUID_INIT_128(BT_UUID_128_ENCODE(0x7a1e0003, 0x3c4b, 0x4a8e, 0x9c1d, 0x50ad2840f00d));

K_MSGQ_DEFINE(lines, 520, 4, 4);
static char lb[520];
static size_t ln;

static bool add_key(const char *hex);

static void kill_fn(struct k_work *w)
{
	if (cc && !authed) bt_conn_disconnect(cc, BT_HCI_ERR_AUTH_FAIL);
}
static K_WORK_DELAYABLE_DEFINE(kill, kill_fn);

static void on_line(struct bt_conn *conn, char *l)
{
	char m[80];

	if (!strcmp(l, "nonce")) {
		uint8_t r[16];

		if (cc && cc != conn && authed) return; /* başka bir telefon ayarda */
		if (cc != conn) {
			if (cc) bt_conn_unref(cc);
			cc = bt_conn_ref(conn);
			tx_reset();
		}
		authed = false;
		bt_rand(r, sizeof(r));
		for (int i = 0; i < 16; i++) sprintf(nonce + 2 * i, "%02x", r[i]);
		snprintf(m, sizeof(m), "{\"ev\":\"auth\",\"n\":\"%s\",\"keys\":%u,\"open\":%d}\n", nonce, nkey, open_now());
		reply(m);
		return;
	}
	if (conn != cc) return;
	if (!strncmp(l, "pair ", 5)) {
		/* tanıtma penceresi açıkken telefon kendi anahtarını bırakır, sonra normal doğrulama yapar */
		if (!open_now() || !add_key(l + 5)) {
			reply("{\"ev\":\"auth\",\"paired\":0}\n");
			return;
		}
		reply("{\"ev\":\"auth\",\"paired\":1}\n");
		OUT("{\"ev\":\"secret\",\"ok\":1,\"n\":%u,\"new\":1}\n", nkey);
		return;
	}
	if (!strncmp(l, "auth ", 5)) {
		uint8_t mac[32];
		char hx[65];
		bool ok = false;

		for (char *q = l + 5; *q; q++) if (*q >= 'A' && *q <= 'F') *q += 'a' - 'A';

		for (int k = 0; k < nkey && nonce[0] && !ok; k++) {
			pm_hmac_sha256(keys[k], 32, (const uint8_t *)nonce, 32, mac);
			for (int i = 0; i < 32; i++) sprintf(hx + 2 * i, "%02x", mac[i]);
			ok = strlen(l + 5) == 64 && !strncmp(hx, l + 5, 64);
		}
		nonce[0] = 0; /* her sayı tek kullanımlık */
		if (!ok) {
			reply("{\"ev\":\"auth\",\"ok\":0}\n");
			/* yanıt gitsin, sonra kes */
			k_work_reschedule(&kill, K_MSEC(400));
			return;
		}
		authed = true;
		reply("{\"ev\":\"auth\",\"ok\":1}\n");
		/* telefonla düşük gecikmeli bağlantı: aktarım hızlı olsun */
		struct bt_le_conn_param p = BT_LE_CONN_PARAM_INIT(6, 24, 0, 400);

		bt_conn_le_param_update(conn, &p);
		ble_out_adv_kick();
		return;
	}
	if (!authed) return;
	/* karttaki yükleyiciye geçiş ve anahtar işlemleri sadece kablodan */
	if (!strcmp(l, "dfu") || !strncmp(l, "secret", 6)) {
		reply("{\"ev\":\"err\",\"where\":\"ble\",\"msg\":\"usb\"}\n");
		return;
	}
	if (k_msgq_put(&lines, l, K_MSEC(300))) reply("{\"ev\":\"err\",\"where\":\"ble\",\"msg\":\"busy\"}\n");
}

static ssize_t rx_write(struct bt_conn *conn, const struct bt_gatt_attr *attr, const void *buf,
			uint16_t len, uint16_t offset, uint8_t flags)
{
	const char *p = buf;

	if (cc && conn != cc && authed) return BT_GATT_ERR(BT_ATT_ERR_WRITE_NOT_PERMITTED);
	for (uint16_t i = 0; i < len; i++) {
		char ch = p[i];

		if (ch == '\n' || ch == '\r') {
			if (ln) {
				lb[ln] = 0;
				ln = 0;
				on_line(conn, lb);
			}
		} else if (ln < sizeof(lb) - 1) {
			lb[ln++] = ch;
		}
	}
	return len;
}

static void ccc_changed(const struct bt_gatt_attr *attr, uint16_t value) { k_sem_give(&tx_sem); }

BT_GATT_SERVICE_DEFINE(pm_cfg_svc,
	BT_GATT_PRIMARY_SERVICE(&svc_uuid),
	BT_GATT_CHARACTERISTIC(&rx_uuid.uuid, BT_GATT_CHRC_WRITE | BT_GATT_CHRC_WRITE_WITHOUT_RESP,
			       BT_GATT_PERM_WRITE, NULL, rx_write, NULL),
	BT_GATT_CHARACTERISTIC(&tx_uuid.uuid, BT_GATT_CHRC_NOTIFY, BT_GATT_PERM_NONE, NULL, NULL, NULL),
	BT_GATT_CCC(ccc_changed, BT_GATT_PERM_READ | BT_GATT_PERM_WRITE),
);

static void tx_thread(void *a, void *b, void *c)
{
	static uint8_t chunk[244];

	while (1) {
		k_sem_take(&tx_sem, K_MSEC(100));
		while (1) {
			struct bt_conn *conn = cc;

			if (!conn || !bt_gatt_is_subscribed(conn, &pm_cfg_svc.attrs[4], BT_GATT_CCC_NOTIFY)) break;
			uint16_t mtu = bt_gatt_get_mtu(conn);
			uint32_t max = MIN(sizeof(chunk), mtu > 3 ? mtu - 3u : 20u);
			k_spinlock_key_t k = k_spin_lock(&txl);
			uint32_t n = ring_buf_peek(&txr, chunk, max);

			k_spin_unlock(&txl, k);
			if (!n) break;
			int err = bt_gatt_notify(conn, &pm_cfg_svc.attrs[4], chunk, n);

			if (err == -ENOMEM || err == -ENOBUFS || err == -EAGAIN) {
				k_sleep(K_MSEC(3));
				continue;
			}
			k = k_spin_lock(&txl);
			ring_buf_get(&txr, NULL, n);
			k_spin_unlock(&txl, k);
			if (err) break;
		}
	}
}
K_THREAD_DEFINE(cfg_tx, 1536, tx_thread, NULL, NULL, NULL, 8, 0, 0);

/* ---------- durum ---------- */

bool ble_cfg_is(struct bt_conn *c) { return c && c == cc && authed; }
bool ble_cfg_authed(void) { return cc && authed; }
bool ble_cfg_want_adv(void) { return want; }

void ble_cfg_disconnected(struct bt_conn *c)
{
	if (c != cc) return;
	authed = false;
	bt_conn_unref(cc);
	cc = NULL;
	ln = 0;
	nonce[0] = 0;
	tx_reset();
	ble_out_adv_kick();
}

bool ble_cfg_line(char *buf, size_t n)
{
	return n >= 520 && k_msgq_get(&lines, buf, K_NO_WAIT) == 0;
}

static void tick_fn(struct k_work *w);
static K_WORK_DELAYABLE_DEFINE(tick, tick_fn);
static void tick_fn(struct k_work *w)
{
	int64_t now = k_uptime_get();

	if (usb_listening()) last_usb = now;
	/* USB'de dinleyen uygulama yoksa kart ayar için Bluetooth'ta görünür */
	bool w2 = !ble_cfg_authed() && now - last_usb >= 5000;

	if (w2 != want) {
		want = w2;
		ble_out_adv_kick();
	}
	k_work_reschedule(&tick, K_SECONDS(1));
}

void ble_cfg_init(void)
{
	bt_addr_le_t ids[2];
	size_t cnt = 2;

	bt_id_get(ids, &cnt);
	if (cnt < 2) bt_id_create(NULL, NULL);
	last_usb = k_uptime_get();
	k_work_reschedule(&tick, K_SECONDS(1));
}

/* ---------- USB komutları ---------- */

static int hv(char c)
{
	if (c >= '0' && c <= '9') return c - '0';
	if (c >= 'a' && c <= 'f') return c - 'a' + 10;
	if (c >= 'A' && c <= 'F') return c - 'A' + 10;
	return -1;
}

static bool add_key(const char *p)
{
	uint8_t k[32];

	if (strlen(p) != 64) return false;
	for (int i = 0; i < 32; i++) {
		int h = hv(p[2 * i]), lo = hv(p[2 * i + 1]);

		if (h < 0 || lo < 0) return false;
		k[i] = h << 4 | lo;
	}
	for (int i = 0; i < nkey; i++) {
		if (!memcmp(keys[i], k, 32)) { OUT("{\"ev\":\"secret\",\"ok\":1,\"n\":%u}\n", nkey); return true; }
	}
	if (nkey == NKEY) { /* en eskiyi at */
		memmove(keys[0], keys[1], 32 * (NKEY - 1));
		nkey--;
	}
	memcpy(keys[nkey++], k, 32);
	keys_save();
	OUT("{\"ev\":\"secret\",\"ok\":1,\"n\":%u,\"new\":1}\n", nkey);
	return true;
}

bool ble_cfg_cmd(char *l)
{
	if (strncmp(l, "secret", 6)) return false;
	if (!strncmp(l, "secret add ", 11)) {
		if (!add_key(l + 11)) goto bad;
		return true;
	}
	if (!strcmp(l, "secret clear")) {
		nkey = 0;
		keys_save();
		if (cc) bt_conn_disconnect(cc, BT_HCI_ERR_REMOTE_USER_TERM_CONN);
		OUT("{\"ev\":\"secret\",\"ok\":1,\"n\":0}\n");
		return true;
	}
	if (!strcmp(l, "secret open")) {
		ble_cfg_open_window();
		return true;
	}
	if (!strcmp(l, "secret count")) {
		OUT("{\"ev\":\"secret\",\"n\":%u}\n", nkey);
		return true;
	}
bad:
	OUT("{\"ev\":\"secret\",\"ok\":0}\n");
	return true;
}
```

## src/ble_cfg.h
```c
/* Telefondan kablosuz ayar: sadece bu karta USB ile bir kez tanıtılmış uygulama bağlanabilir. */
#pragma once
#include <stdbool.h>
#include <stdarg.h>
#include <zephyr/bluetooth/conn.h>
#include <zephyr/bluetooth/uuid.h>

#define PM_CFG_UUID_BYTES BT_UUID_128_ENCODE(0x7a1e0001, 0x3c4b, 0x4a8e, 0x9c1d, 0x50ad2840f00d)
/* ayar için yayın yapılan ikinci kimlik (eşleşmiş hedefler bunu tanımaz, kendiliğinden bağlanmaz) */
#define PM_CFG_ID 1

void ble_cfg_init(void);
/* doğrulanmış ayar telefonu bu bağlantı mı */
bool ble_cfg_is(struct bt_conn *c);
/* doğrulanmış bir ayar telefonu bağlı mı */
bool ble_cfg_authed(void);
/* ayar telefonu için yayın gerekli mi */
bool ble_cfg_want_adv(void);
void ble_cfg_disconnected(struct bt_conn *c);
/* OUT çıktısını telefona da gönder */
void ble_cfg_vout(const char *fmt, va_list ap);
/* telefondan gelen bir satırı al (cfg iş parçacığı) */
bool ble_cfg_line(char *buf, size_t n);
/* USB'den: secret add <64 hex> | secret clear | secret count */
bool ble_cfg_cmd(char *l);
/* 60 sn tanıtma penceresi (yeni telefon kablosuz tanıtılabilir) */
void ble_cfg_open_window(void);
```

## src/ble_out.c
```c
/*
 * Bluetooth çıkış: kart hedef cihaza (PC, tablet, TV) Bluetooth klavye + fare + gamepad olarak bağlanır.
 *
 * Kurallar:
 *  - Tuşların nereye gideceği (kablo / Bluetooth) kartta saklanır ("route").
 *  - Kablo takılı değilse (powerbank) ya da route = Bluetooth ise kart hedef cihaza görünür olur.
 *  - Sadece "yeni cihaz eşle" modunda (60 sn) yeni bir cihaz eşleşebilir; diğer zamanlarda
 *    sadece önceden eşleşmiş hedefler bağlanabilir.
 *  - Birden çok hedef eşleşmişse seçili hedef ("target") öncelikli; başka hedef bağlanırsa
 *    seçili olan değilse bağlantı kesilir.
 *
 * Ayar ekranı komutları (cfg.c → ble_cmd):
 *   route 0|1      kablo / Bluetooth
 *   pair           60 sn yeni cihaz eşleme
 *   targets        hedef listesi → {"ev":"targets",...}
 *   target <adr>   seçili hedef
 *   unpair <adr>   hedefi unut
 */
#include <stdio.h>
#include <string.h>
#include <zephyr/kernel.h>
#include <zephyr/bluetooth/bluetooth.h>
#include <zephyr/bluetooth/conn.h>
#include <zephyr/bluetooth/gatt.h>
#include <zephyr/bluetooth/uuid.h>
#include <zephyr/settings/settings.h>
#include <bluetooth/services/hids.h>
#include "log.h"
#include "ble_out.h"
#include "ble_cfg.h"

/* klavye (1), fare (2), gamepad (3) */
static const uint8_t report_map[] = {
	/* klavye */
	0x05, 0x01, 0x09, 0x06, 0xa1, 0x01, 0x85, 0x01,
	0x05, 0x07, 0x19, 0xe0, 0x29, 0xe7, 0x15, 0x00, 0x25, 0x01, 0x75, 0x01, 0x95, 0x08, 0x81, 0x02,
	0x95, 0x01, 0x75, 0x08, 0x81, 0x01,
	0x95, 0x06, 0x75, 0x08, 0x15, 0x00, 0x25, 0x65, 0x05, 0x07, 0x19, 0x00, 0x29, 0x65, 0x81, 0x00,
	0xc0,
	/* fare */
	0x05, 0x01, 0x09, 0x02, 0xa1, 0x01, 0x85, 0x02, 0x09, 0x01, 0xa1, 0x00,
	0x05, 0x09, 0x19, 0x01, 0x29, 0x05, 0x15, 0x00, 0x25, 0x01, 0x95, 0x05, 0x75, 0x01, 0x81, 0x02,
	0x95, 0x01, 0x75, 0x03, 0x81, 0x01,
	0x05, 0x01, 0x09, 0x30, 0x09, 0x31, 0x09, 0x38, 0x15, 0x81, 0x25, 0x7f, 0x75, 0x08, 0x95, 0x03, 0x81, 0x06,
	0xc0, 0xc0,
	/* gamepad (USB'dekiyle aynı 9 bayt) */
	0x05, 0x01, 0x09, 0x05, 0xa1, 0x01, 0x85, 0x03,
	0x05, 0x09, 0x19, 0x01, 0x29, 0x10, 0x15, 0x00, 0x25, 0x01, 0x75, 0x01, 0x95, 0x10, 0x81, 0x02,
	0x05, 0x01, 0x09, 0x39, 0x15, 0x00, 0x25, 0x07, 0x35, 0x00, 0x46, 0x3b, 0x01,
	0x65, 0x14, 0x75, 0x04, 0x95, 0x01, 0x81, 0x42,
	0x65, 0x00, 0x75, 0x04, 0x95, 0x01, 0x81, 0x01,
	0x09, 0x30, 0x09, 0x31, 0x09, 0x32, 0x09, 0x35, 0x15, 0x00, 0x26, 0xff, 0x00, 0x75, 0x08, 0x95, 0x04, 0x81, 0x02,
	0x05, 0x02, 0x09, 0xc5, 0x09, 0xc4, 0x15, 0x00, 0x26, 0xff, 0x00, 0x75, 0x08, 0x95, 0x02, 0x81, 0x02,
	0xc0,
	/* medya tuşları (4) */
	0x05, 0x0c, 0x09, 0x01, 0xa1, 0x01, 0x85, 0x04,
	0x15, 0x00, 0x26, 0xff, 0x03, 0x19, 0x00, 0x2a, 0xff, 0x03, 0x75, 0x10, 0x95, 0x01, 0x81, 0x00,
	0xc0,
};

BT_HIDS_DEF(hids_obj, 8, 4, 9, 2);

static struct bt_conn *host;          /* bağlı hedef */
static volatile bool host_ready;      /* şifreli ve bildirimler açık */
static uint8_t route;                 /* 0 kablo, 1 Bluetooth (kartta saklanır) */
static bt_addr_le_t target;           /* seçili hedef (kimlik adresi) */
static bool target_set;
static volatile bool pairing;
static bool adv_on;
static bool usb_present;

extern bool pad_addr_known(const bt_addr_le_t *a);

/* ---------- saklama ---------- */

/* Bluetooth'ta görünen ad: ayar sayfasının adresini taşır, ayarlardan değiştirilebilir */
#define NAME_DEF "pmape.github.io"
static char devname[30] = NAME_DEF;

static int h_set(const char *key, size_t len, settings_read_cb rd, void *arg)
{
	if (!strcmp(key, "name")) {
		char b[30] = "";
		int n = rd(arg, b, sizeof(b) - 1);

		if (n > 0) { b[n] = 0; strcpy(devname, b); }
		return 0;
	}
	if (!strcmp(key, "route")) { rd(arg, &route, 1); return 0; }
	if (!strcmp(key, "target")) { target_set = rd(arg, &target, sizeof(target)) == sizeof(target); return 0; }
	return -ENOENT;
}
SETTINGS_STATIC_HANDLER_DEFINE(pmb, "pmb", NULL, h_set, NULL, NULL);

/* ---------- görünürlük ---------- */

/* reklam 31 bayt: 128 bitlik kimlik reklamda, ad (en fazla 29 bayt) tarama yanıtında tek başına */
static const struct bt_data ad[] = {
	BT_DATA_BYTES(BT_DATA_GAP_APPEARANCE, 0xc4, 0x03), /* gamepad */
	BT_DATA_BYTES(BT_DATA_FLAGS, (BT_LE_AD_GENERAL | BT_LE_AD_NO_BREDR)),
	BT_DATA_BYTES(BT_DATA_UUID16_ALL, BT_UUID_16_ENCODE(BT_UUID_HIDS_VAL)),
};
static struct bt_data sd[] = {
	BT_DATA(BT_DATA_NAME_COMPLETE, devname, 0),
};
/* sadece ayar telefonu için (ikinci kimlik): HID olarak görünmez */
static const struct bt_data cfg_ad[] = {
	BT_DATA_BYTES(BT_DATA_FLAGS, (BT_LE_AD_GENERAL | BT_LE_AD_NO_BREDR)),
	BT_DATA_BYTES(BT_DATA_UUID128_ALL, PM_CFG_UUID_BYTES),
};
/* ayar yayınının adı: "Ayar " + kartın adı (Bluetooth listesinde oyun bağlantısıyla karışmasın) */
static char cfgname[30];
static struct bt_data cfg_sd[] = {
	BT_DATA(BT_DATA_NAME_COMPLETE, cfgname, 0),
};

static void name_apply(void)
{
	sd[0].data_len = strlen(devname);
	snprintf(cfgname, sizeof(cfgname), "Ayar %s", devname);
	cfg_sd[0].data_len = strlen(cfgname);
	bt_set_name(devname);
}
/* İki ayrı yayın aynı anda: oyun bağlantısı (gamepad, varsayılan kimlik) ve ayar (ikinci kimlik, HID yok).
 * Böylece bilgisayar/telefon ayar için bağlanınca kendini gamepad'e bağlanıyor sanıp eşleşmeye
 * kalkmaz, kopma olmaz; oyun bağlantısı da ayar bağlantısından bağımsız görünür kalır. */
static struct bt_le_ext_adv *set_host, *set_cfg;
static bool on_host, on_cfg;

static void adv_connected(struct bt_le_ext_adv *a, struct bt_le_ext_adv_connected_info *info)
{
	if (a == set_host) on_host = false;
	if (a == set_cfg) on_cfg = false;
	adv_on = on_host;
}
static const struct bt_le_ext_adv_cb adv_cb = { .connected = adv_connected };

static void adv_sync(struct bt_le_ext_adv **set, bool *on, bool want, uint8_t id, uint32_t imin, uint32_t imax,
		     const struct bt_data *a, size_t na, const struct bt_data *d, size_t nd)
{
	int err;

	if (*on && !want) {
		bt_le_ext_adv_stop(*set);
		*on = false;
	}
	if (!want || *on) return;
	if (!*set) {
		struct bt_le_adv_param p = BT_LE_ADV_PARAM_INIT(BT_LE_ADV_OPT_CONNECTABLE, imin, imax, NULL);

		p.id = id;
		err = bt_le_ext_adv_create(&p, &adv_cb, set);
		if (err) { OUT("{\"ev\":\"ble\",\"adv_err\":%d,\"id\":%u}\n", err, id); *set = NULL; return; }
	}
	err = bt_le_ext_adv_set_data(*set, a, na, d, nd);
	if (!err) err = bt_le_ext_adv_start(*set, BT_LE_EXT_ADV_START_DEFAULT);
	*on = (err == 0 || err == -EALREADY);
	if (err && err != -EALREADY) OUT("{\"ev\":\"ble\",\"adv_err\":%d,\"id\":%u}\n", err, id);
}

static void adv_update(struct k_work *w)
{
	/* oyun: bağlı hedef yoksa (eşleme modu, Bluetooth çıkışı ya da USB'de veri yok) */
	bool for_host = !host && (pairing || route == 1 || !usb_present);
	/* ayar: USB'de dinleyen uygulama yoksa */
	bool for_cfg = ble_cfg_want_adv();

	/* oyun yayını hızlı (20–30 ms): hedef kartı hemen görsün, çabuk geri bağlansın */
	adv_sync(&set_host, &on_host, for_host, BT_ID_DEFAULT, BT_GAP_ADV_FAST_INT_MIN_1 * 2 / 3, BT_GAP_ADV_FAST_INT_MIN_1,
		 ad, ARRAY_SIZE(ad), sd, ARRAY_SIZE(sd));
	/* ayar yayını yavaş (100–150 ms): pad bağlantısının süresinden çalmasın */
	adv_sync(&set_cfg, &on_cfg, for_cfg, PM_CFG_ID, BT_GAP_ADV_FAST_INT_MIN_2, BT_GAP_ADV_FAST_INT_MAX_2,
		 cfg_ad, ARRAY_SIZE(cfg_ad), cfg_sd, ARRAY_SIZE(cfg_sd));
	adv_on = on_host;
}
static K_WORK_DEFINE(adv_work, adv_update);
static void adv_kick(void) { k_work_submit(&adv_work); }

static void pair_end_fn(struct k_work *w)
{
	pairing = false;
	OUT("{\"ev\":\"ble\",\"pairing\":0}\n");
	adv_kick();
}
static K_WORK_DELAYABLE_DEFINE(pair_end, pair_end_fn);

/* ---------- bağlantı (sadece hedef rolü) ---------- */

static bool is_host_role(struct bt_conn *c)
{
	struct bt_conn_info i;

	return bt_conn_get_info(c, &i) == 0 && i.role == BT_CONN_ROLE_PERIPHERAL;
}

/* hedefi bırak: ayar telefonuyla aynı bağlantıysa bağlantıyı kesme, sadece hedef rolünü al */
static void drop_host(void)
{
	if (!host) return;
	if (ble_cfg_is(host)) {
		bt_conn_unref(host);
		host = NULL;
		host_ready = false;
		adv_kick();
	} else {
		bt_conn_disconnect(host, BT_HCI_ERR_REMOTE_USER_TERM_CONN);
	}
}

static void addr_str(const bt_addr_le_t *a, char *s, size_t n) { bt_addr_le_to_str(a, s, n); }

/* Çevre rolündeki bağlantılar: hedef cihaz ya da ayar yapan telefon. Kim olduğu belli olana kadar
 * "bekleyen" sayılır; 20 sn içinde hedef (şifreli) ya da doğrulanmış telefon olmazsa kesilir. */
#define MAXP 3
static struct { struct bt_conn *c; int64_t at; bool sec; } pend[MAXP];

static void pend_add(struct bt_conn *c, bool sec)
{
	for (int i = 0; i < MAXP; i++) {
		if (!pend[i].c) { pend[i].c = bt_conn_ref(c); pend[i].at = k_uptime_get(); pend[i].sec = sec; return; }
	}
}

struct bond_q { const bt_addr_le_t *a; bool found; };

static void bond_q_cb(const struct bt_bond_info *info, void *user)
{
	struct bond_q *q = user;

	if (!bt_addr_le_cmp(&info->addr, q->a)) q->found = true;
}

static bool is_bonded(const bt_addr_le_t *a)
{
	struct bond_q q = { a, false };

	bt_foreach_bond(BT_ID_DEFAULT, bond_q_cb, &q);
	return q.found;
}

static uint8_t conn_id(struct bt_conn *c)
{
	struct bt_conn_info i;

	return bt_conn_get_info(c, &i) == 0 ? i.id : BT_ID_DEFAULT;
}

static void pend_del(struct bt_conn *c)
{
	for (int i = 0; i < MAXP; i++) if (pend[i].c == c) { bt_conn_unref(pend[i].c); pend[i].c = NULL; }
}

static void vet_fn(struct k_work *w);
static K_WORK_DELAYABLE_DEFINE(vet, vet_fn);
static void vet_fn(struct k_work *w)
{
	int64_t now = k_uptime_get();
	bool any = false;

	for (int i = 0; i < MAXP; i++) {
		struct bt_conn *c = pend[i].c;

		if (!c) continue;
		if (c == host || ble_cfg_is(c)) { pend_del(c); continue; }
		/* eşleme modunda yeni cihaz: önce telefon mu diye kısa bekle, sonra şifrelemeyi başlat */
		if (!pend[i].sec && pairing && conn_id(c) == BT_ID_DEFAULT && now - pend[i].at > 2500) {
			pend[i].sec = true;
			bt_conn_set_security(c, BT_SECURITY_L2);
		}
		if (now - pend[i].at > 20000) {
			bt_conn_disconnect(c, BT_HCI_ERR_REMOTE_USER_TERM_CONN);
			pend_del(c);
			continue;
		}
		any = true;
	}
	if (any) k_work_reschedule(&vet, K_SECONDS(1));
}

static void connected(struct bt_conn *conn, uint8_t err)
{
	if (!is_host_role(conn)) return;
	if (err) { adv_kick(); return; }
	bt_hids_connected(&hids_obj, conn);
	/* eşleşmiş bir hedef: şifrelemeyi kart hemen başlatsın (hızlı geri bağlanma) */
	bool bonded = conn_id(conn) == BT_ID_DEFAULT && is_bonded(bt_conn_get_dst(conn));

	pend_add(conn, bonded);
	k_work_reschedule(&vet, K_SECONDS(1));
	if (bonded) bt_conn_set_security(conn, BT_SECURITY_L2);
	OUT("{\"ev\":\"ble\",\"host\":\"connecting\"}\n");
	adv_kick();
}

static void disconnected(struct bt_conn *conn, uint8_t reason)
{
	if (!is_host_role(conn)) return;
	bt_hids_disconnected(&hids_obj, conn);
	pend_del(conn);
	ble_cfg_disconnected(conn);
	if (conn == host) {
		bt_conn_unref(host);
		host = NULL;
		host_ready = false;
		OUT("{\"ev\":\"ble\",\"host\":\"\",\"reason\":%u}\n", reason);
	}
	adv_kick();
}

static void security_changed(struct bt_conn *conn, bt_security_t level, enum bt_security_err err)
{
	char s[BT_ADDR_LE_STR_LEN];

	if (!is_host_role(conn) || conn_id(conn) != BT_ID_DEFAULT) return;
	/* Uygun olmayan bağlantılar hemen kesilmez: ayar telefonu da olabilir. 20 sn içinde
	 * doğrulanmazsa vet_fn keser. */
	if (err) return;
	if (host && host != conn) return; /* zaten bir hedef var */
	const bt_addr_le_t *a = bt_conn_get_dst(conn);

	/* şu an bağlı hedef yok: şifreli bağlanan (eşleşmiş) cihaz hedef olur; en son bağlanan hatırlanır */
	if (!target_set || bt_addr_le_cmp(a, &target)) {
		target = *a;
		target_set = true;
		settings_save_one("pmb/target", &target, sizeof(target));
	}
	if (!host) host = bt_conn_ref(conn);
	pend_del(conn);
	host_ready = true;
	addr_str(a, s, sizeof(s));
	OUT("{\"ev\":\"ble\",\"host\":\"%s\"}\n", s);
	/* en kısa aralık (7,5–11 ms) ve 2M PHY: daha az gecikme */
	struct bt_le_conn_param p = BT_LE_CONN_PARAM_INIT(6, 9, 0, 400);

	bt_conn_le_param_update(conn, &p);
	bt_conn_le_phy_update(conn, BT_CONN_LE_PHY_PARAM_2M);
	adv_kick();
}

void ble_out_adv_kick(void) { adv_kick(); }

BT_CONN_CB_DEFINE(ble_out_cb) = {
	.connected = connected,
	.disconnected = disconnected,
	.security_changed = security_changed,
};

/* Eşleme sadece pad tarafında ya da eşleme modunda kabul edilir */
static enum bt_security_err pairing_accept(struct bt_conn *conn, const struct bt_conn_pairing_feat *const feat)
{
	if (!is_host_role(conn)) return BT_SECURITY_ERR_SUCCESS;
	/* oyun bağlantısı: eşleme modunda ya da kart şu an hiçbir cihaza bağlı değilken yeni cihaz eşleşebilir
	 * (kartı güce tak, bilgisayarda Bluetooth'tan ekle: başka bir şeye basmak gerekmez) */
	if (conn_id(conn) == BT_ID_DEFAULT && !ble_cfg_is(conn) && (pairing || !host)) return BT_SECURITY_ERR_SUCCESS;
	return BT_SECURITY_ERR_PAIR_NOT_ALLOWED;
}

static void pairing_complete(struct bt_conn *conn, bool bonded)
{
	if (is_host_role(conn)) OUT("{\"ev\":\"ble\",\"paired\":%d}\n", bonded);
}

static struct bt_conn_auth_cb auth_cb = { .pairing_accept = pairing_accept };
static struct bt_conn_auth_info_cb auth_info_cb = { .pairing_complete = pairing_complete };

/* ---------- gönderim ---------- */

bool ble_out_ready(void) { return host && host_ready; }
bool ble_out_route_bt(void) { return route == 1; }
bool ble_out_searching(void) { return adv_on && !host; }

int ble_out_send(int which, const uint8_t *buf, uint8_t len)
{
	/* which: 0 klavye, 1 fare, 2 gamepad, 3 medya = rapor sırası */
	if (!ble_out_ready()) return -ENOTCONN;
	return bt_hids_inp_rep_send(&hids_obj, host, which, buf, len, NULL);
}

void ble_out_usb(bool present)
{
	if (usb_present == present) return;
	usb_present = present;
	adv_kick();
}

void ble_out_set_route(int r)
{
	route = r ? 1 : 0;
	settings_save_one("pmb/route", &route, 1);
	OUT("{\"ev\":\"ble\",\"route\":%u}\n", route);
	if (route == 0 && host && !usb_present) {
		/* kablo yoksa Bluetooth'ta kal */
	}
	adv_kick();
}

int ble_out_route(void) { return route; }

/* ---------- komutlar ---------- */

struct list_ctx { int n; };

static void bond_cb(const struct bt_bond_info *info, void *user)
{
	struct list_ctx *c = user;
	char s[BT_ADDR_LE_STR_LEN];

	if (pad_addr_known(&info->addr)) return; /* pad'ler hedef değildir */
	addr_str(&info->addr, s, sizeof(s));
	OUT("%s\"%s\"", c->n++ ? "," : "", s);
}

static void print_targets(void)
{
	struct list_ctx c = { 0 };
	char s[BT_ADDR_LE_STR_LEN] = "", h[BT_ADDR_LE_STR_LEN] = "";

	if (target_set) addr_str(&target, s, sizeof(s));
	if (host && host_ready) addr_str(bt_conn_get_dst(host), h, sizeof(h));
	OUT("{\"ev\":\"targets\",\"list\":[");
	bt_foreach_bond(BT_ID_DEFAULT, bond_cb, &c);
	OUT("],\"target\":\"%s\",\"host\":\"%s\",\"route\":%u,\"pairing\":%d,\"usb\":%d}\n",
	    s, h, route, pairing, usb_present);
}

static int parse(const char *str, bt_addr_le_t *a)
{
	char buf[40];
	const char *type = "random";

	strncpy(buf, str, sizeof(buf) - 1);
	buf[sizeof(buf) - 1] = 0;
	char *t = strchr(buf, ' ');

	if (t) {
		*t++ = 0;
		if (*t == '(') t++;
		char *e = strchr(t, ')');

		if (e) *e = 0;
		type = t;
	}
	return bt_addr_le_from_str(buf, type, a);
}

bool ble_cmd(char *l)
{
	bt_addr_le_t a;

	if (!strncmp(l, "route ", 6)) {
		ble_out_set_route(l[6] == '1');
		print_targets();
		return true;
	}
	if (!strcmp(l, "pair")) {
		pairing = true;
		/* başka bir hedefe bağlıysa yeni cihaz için boşalt */
		drop_host();
		k_work_reschedule(&pair_end, K_SECONDS(60));
		OUT("{\"ev\":\"ble\",\"pairing\":1}\n");
		adv_kick();
		return true;
	}
	if (!strcmp(l, "targets")) {
		print_targets();
		return true;
	}
	if (!strcmp(l, "name")) {
		OUT("{\"ev\":\"name\",\"name\":\"%s\",\"def\":\"" NAME_DEF "\"}\n", devname);
		return true;
	}
	if (!strncmp(l, "name ", 5)) {
		/* düz ASCII, tırnak ve ters bölü yok, en fazla 29 karakter; boş = varsayılan */
		const char *n = l + 5;
		char b[30];
		size_t k = 0;

		for (; *n && k < sizeof(b) - 1; n++) {
			if (*n >= 32 && *n < 127 && *n != '"' && *n != '\\') b[k++] = *n;
		}
		b[k] = 0;
		strcpy(devname, k ? b : NAME_DEF);
		settings_save_one("pmb/name", devname, strlen(devname));
		name_apply();
		/* yayınların içeriği değişti: durdurup yeniden başlat */
		if (on_host) { bt_le_ext_adv_stop(set_host); on_host = false; }
		if (on_cfg) { bt_le_ext_adv_stop(set_cfg); on_cfg = false; }
		adv_kick();
		OUT("{\"ev\":\"name\",\"name\":\"%s\",\"def\":\"" NAME_DEF "\"}\n", devname);
		return true;
	}
	if (!strncmp(l, "target ", 7)) {
		if (parse(l + 7, &a)) return true;
		target = a;
		target_set = true;
		settings_save_one("pmb/target", &target, sizeof(target));
		if (host && bt_addr_le_cmp(bt_conn_get_dst(host), &a)) drop_host();
		print_targets();
		return true;
	}
	if (!strncmp(l, "unpair ", 7)) {
		if (parse(l + 7, &a)) return true;
		if (host && !bt_addr_le_cmp(bt_conn_get_dst(host), &a)) drop_host();
		bt_unpair(BT_ID_DEFAULT, &a);
		if (target_set && !bt_addr_le_cmp(&target, &a)) {
			target_set = false;
			settings_delete("pmb/target");
		}
		print_targets();
		return true;
	}
	return false;
}

/* main.c, bt_enable ve settings_load'dan sonra çağırır */
int ble_out_init(void)
{
	struct bt_hids_init_param p = { 0 };
	struct bt_hids_inp_rep *r;
	static const uint8_t sizes[4] = { 8, 4, 9, 2 };

	name_apply();
	p.rep_map.data = report_map;
	p.rep_map.size = sizeof(report_map);
	p.info.bcd_hid = 0x0101;
	p.info.b_country_code = 0;
	p.info.flags = BT_HIDS_REMOTE_WAKE | BT_HIDS_NORMALLY_CONNECTABLE;
	for (int i = 0; i < 4; i++) {
		r = &p.inp_rep_group_init.reports[i];
		r->size = sizes[i];
		r->id = i + 1;
		p.inp_rep_group_init.cnt++;
	}
	int err = bt_hids_init(&hids_obj, &p);

	if (err) {
		OUT("{\"ev\":\"ble\",\"hids_err\":%d}\n", err);
		return err;
	}
	bt_conn_auth_cb_register(&auth_cb);
	bt_conn_auth_info_cb_register(&auth_info_cb);
	adv_kick();
	return 0;
}
```

## src/ble_out.h
```c
#pragma once
#include <stdbool.h>
#include <stdint.h>

int ble_out_init(void);
/* hedef bağlı ve şifreli mi */
bool ble_out_ready(void);
/* hedef aranıyor (yayın açık, bağlı değil) */
bool ble_out_searching(void);
/* seçilen yol Bluetooth mu (kartta saklı) */
bool ble_out_route_bt(void);
int ble_out_route(void);
void ble_out_set_route(int r);
/* 0 klavye, 1 fare, 2 gamepad */
int ble_out_send(int which, const uint8_t *buf, uint8_t len);
/* USB'de veri bağlantısı var mı (yoksa güç kaynağına takılı demektir) */
void ble_out_usb(bool present);
bool ble_cmd(char *l);
/* yayını yeniden değerlendir (ayar telefonu bağlanınca/ayrılınca) */
void ble_out_adv_kick(void);
```

## src/cfg.c
```c
/*
 * Ayar ekranıyla konuşma (USB seri) ve ayarı kartın hafızasında saklama.
 *
 * Ekrandan karta (satır satır):
 *   hello            → {"ev":"hello","fw":"..","cfg":uzunluk,"crc":"..","prof":n,"mapping":0/1}
 *   cb <uzunluk>     ayar gönderimi başlıyor
 *   cd <hex>         ayar parçası
 *   ce <crc32 hex>   bitti: denetle, kaydet, uygula → {"ev":"cfg","ok":1} ya da {"ev":"cfg","ok":0,"err":..}
 *   cs <n>           profil seç → {"ev":"prof","cur":n}
 *   map <0|1>        eşlemeyi kapat / aç
 */
#include <string.h>
#include <stdlib.h>
#include <zephyr/kernel.h>
#include <zephyr/device.h>
#include <zephyr/drivers/uart.h>
#include <zephyr/settings/settings.h>
#include <zephyr/sys/crc.h>
#include <zephyr/sys/reboot.h>
#include <soc.h>
#include "log.h"
#include "engine.h"
#include "out.h"
#include "cfg.h"
#include "ble_out.h"
#include "ble_cfg.h"
#include "hid_in.h"

#define CHUNK 1024

static uint8_t blob[CFG_MAX];
static size_t blob_len;
static uint8_t rx[CFG_MAX];
static size_t rx_len, rx_expect;
static int saved_prof = -1;
/* Ayar ekranının profilleri (düzenlenebilir hali, sıkıştırılmış JSON): karttan geri alınabilsin */
#define JMAX 8192
static uint8_t jblob[JMAX];
static size_t jlen;
static bool rx_json;

/* ---------- hafıza ---------- */

static int h_set(const char *key, size_t len, settings_read_cb read_cb, void *arg)
{
	if (!strcmp(key, "len")) {
		uint16_t v = 0;

		if (read_cb(arg, &v, sizeof(v)) == sizeof(v) && v <= CFG_MAX) blob_len = v;
		return 0;
	}
	if (!strcmp(key, "prof")) {
		uint8_t v;

		if (read_cb(arg, &v, 1) == 1) saved_prof = v;
		return 0;
	}
	if (key[0] == 'c') {
		int n = atoi(key + 1);

		if (n >= 0 && (n + 1) * CHUNK <= CFG_MAX && len <= CHUNK) read_cb(arg, blob + n * CHUNK, len);
		return 0;
	}
	return -ENOENT;
}

static int h_commit(void)
{
	if (blob_len && engine_set_config(blob, blob_len) == 0) {
		if (saved_prof >= 0) engine_select_profile(saved_prof);
	}
	return 0;
}

SETTINGS_STATIC_HANDLER_DEFINE(pm, "pm", NULL, h_set, h_commit, NULL);

static int hj_set(const char *key, size_t len, settings_read_cb read_cb, void *arg)
{
	if (!strcmp(key, "len")) {
		uint16_t v = 0;

		if (read_cb(arg, &v, sizeof(v)) == sizeof(v) && v <= JMAX) jlen = v;
		return 0;
	}
	if (key[0] == 'c') {
		int n = atoi(key + 1);

		if (n >= 0 && (n + 1) * CHUNK <= JMAX && len <= CHUNK) read_cb(arg, jblob + n * CHUNK, len);
		return 0;
	}
	return -ENOENT;
}

SETTINGS_STATIC_HANDLER_DEFINE(pmj, "pmj", NULL, hj_set, NULL, NULL);

static int store_in(const char *pre, const uint8_t *b, size_t len)
{
	char key[16];
	uint16_t l = len;
	int err;

	for (size_t off = 0, n = 0; off < len; off += CHUNK, n++) {
		snprintk(key, sizeof(key), "%s/c%u", pre, (unsigned)n);
		err = settings_save_one(key, b + off, MIN(CHUNK, len - off));
		if (err) return err;
	}
	snprintk(key, sizeof(key), "%s/len", pre);
	return settings_save_one(key, &l, sizeof(l));
}

static int store(const uint8_t *b, size_t len) { return store_in("pm", b, len); }

/* hex olarak parça parça yaz */
static void dump(const char *ev, const uint8_t *b, size_t len)
{
	static const char hx[] = "0123456789abcdef";

	for (size_t off = 0; off < len; off += 200) {
		size_t n = MIN(200, len - off);

		OUT("{\"ev\":\"%s\",\"d\":\"", ev);
		for (size_t i = 0; i < n; i++) OUT("%c%c", hx[b[off + i] >> 4], hx[b[off + i] & 15]);
		OUT("\"}\n");
	}
	OUT("{\"ev\":\"%s_end\",\"len\":%u}\n", ev, (unsigned)len);
}

static void prof_save(struct k_work *w);
static K_WORK_DELAYABLE_DEFINE(prof_work, prof_save);
static void prof_save(struct k_work *w)
{
	uint8_t v = engine_profile();

	settings_save_one("pm/prof", &v, 1);
}

void engine_profile_changed(int n)
{
	k_work_reschedule(&prof_work, K_MSEC(1500));
}

/* ---------- komutlar ---------- */

static int hexval(char c)
{
	if (c >= '0' && c <= '9') return c - '0';
	if (c >= 'a' && c <= 'f') return c - 'a' + 10;
	if (c >= 'A' && c <= 'F') return c - 'A' + 10;
	return -1;
}

static void hello(void)
{
	OUT("{\"ev\":\"hello\",\"fw\":\"%s\",\"cfg\":%u,\"crc\":\"%08x\",\"prof\":%d,\"nprof\":%d,\"mapping\":%d,\"jlen\":%u,\"jcrc\":\"%08x\"}\n",
	    FW_VERSION, (unsigned)blob_len, blob_len ? crc32_ieee(blob, blob_len) : 0,
	    engine_profile(), engine_profile_count(), engine_mapping(),
	    (unsigned)jlen, jlen ? crc32_ieee(jblob, jlen) : 0);
}

extern bool bt_cmd(char *l);

static void cmd(char *l)
{
	if (bt_cmd(l)) return;
	if (ble_cmd(l)) return;
	if (ble_cfg_cmd(l)) return;
	if (hid_cmd(l)) return;
	if (!strcmp(l, "hello")) {
		hello();
		out_state_request();
	} else if (!strcmp(l, "state")) {
		out_state_request();
	} else if (!strcmp(l, "dfu")) {
		/* Yükleme moduna geç: kart USB sürücü olarak açılır, yeni UF2 oraya yazılır */
		OUT("{\"ev\":\"dfu\",\"ok\":1}\n");
		k_sleep(K_MSEC(300));
		NRF_POWER->GPREGRET = 0x57; /* UF2 yükleyicisi */
		sys_reboot(SYS_REBOOT_COLD);
	} else if (!strcmp(l, "cr")) {
		dump("cfgdata", blob, blob_len);
	} else if (!strcmp(l, "jr")) {
		dump("jdata", jblob, jlen);
	} else if (!strncmp(l, "jb ", 3)) {
		rx_expect = strtoul(l + 3, NULL, 10);
		rx_len = 0;
		rx_json = true;
		if (rx_expect > JMAX) {
			OUT("{\"ev\":\"json\",\"ok\":0,\"err\":\"büyük\"}\n");
			rx_expect = 0;
		}
	} else if (!strncmp(l, "je ", 3)) {
		uint32_t want = strtoul(l + 3, NULL, 16);

		if (!rx_json || !rx_expect || rx_len != rx_expect || want != crc32_ieee(rx, rx_len)) {
			OUT("{\"ev\":\"json\",\"ok\":0,\"err\":\"eksik\"}\n");
			return;
		}
		memcpy(jblob, rx, rx_len);
		jlen = rx_len;
		rx_expect = 0;
		rx_json = false;
		OUT("{\"ev\":\"json\",\"ok\":1,\"saved\":%d}\n", store_in("pmj", jblob, jlen) == 0);
	} else if (!strncmp(l, "cb ", 3)) {
		rx_json = false;
		rx_expect = strtoul(l + 3, NULL, 10);
		rx_len = 0;
		if (rx_expect > CFG_MAX) {
			OUT("{\"ev\":\"cfg\",\"ok\":0,\"err\":\"büyük\"}\n");
			rx_expect = 0;
		}
	} else if (!strncmp(l, "cd ", 3) || !strncmp(l, "jd ", 3)) {
		for (char *p = l + 3; p[0] && p[1] && rx_len < rx_expect; p += 2) {
			int h = hexval(p[0]), lo = hexval(p[1]);

			if (h < 0 || lo < 0) break;
			rx[rx_len++] = (h << 4) | lo;
		}
	} else if (!strncmp(l, "ce ", 3)) {
		uint32_t want = strtoul(l + 3, NULL, 16);
		uint32_t got = crc32_ieee(rx, rx_len);
		int e;

		if (!rx_expect || rx_len != rx_expect || want != got) {
			OUT("{\"ev\":\"cfg\",\"ok\":0,\"err\":\"eksik\",\"len\":%u,\"want\":%u}\n",
			    (unsigned)rx_len, (unsigned)rx_expect);
			return;
		}
		e = engine_check(rx, rx_len);
		if (e) {
			OUT("{\"ev\":\"cfg\",\"ok\":0,\"err\":\"bicim\",\"code\":%d}\n", e);
			return;
		}
		memcpy(blob, rx, rx_len);
		blob_len = rx_len;
		engine_set_config(blob, blob_len);
		e = store(blob, blob_len);
		rx_expect = 0;
		OUT("{\"ev\":\"cfg\",\"ok\":1,\"saved\":%d}\n", e == 0);
		hello();
	} else if (!strncmp(l, "cs ", 3)) {
		if (engine_select_profile(atoi(l + 3)) == 0) {
			engine_profile_changed(engine_profile());
			OUT("{\"ev\":\"prof\",\"cur\":%d}\n", engine_profile());
		}
	} else if (!strncmp(l, "live ", 5)) {
		out_live(atoi(l + 5));
	} else if (!strncmp(l, "map ", 4)) {
		engine_set_mapping(l[4] == '1');
		OUT("{\"ev\":\"mode\",\"mapping\":%d}\n", engine_mapping());
	}
}

static void rx_thread(void *a, void *b, void *c)
{
	const struct device *con = DEVICE_DT_GET(DT_CHOSEN(zephyr_console));
	static char line[600];
	size_t n = 0;
	unsigned char ch;

	static char bl[520];

	while (1) {
		/* telefondan (Bluetooth) gelen satırlar */
		while (ble_cfg_line(bl, sizeof(bl))) cmd(bl);
		if (!device_is_ready(con) || uart_poll_in(con, &ch) != 0) {
			k_sleep(K_MSEC(3));
			continue;
		}
		if (ch == '\n' || ch == '\r') {
			if (n) {
				line[n] = 0;
				cmd(line);
				n = 0;
			}
		} else if (n < sizeof(line) - 1) {
			line[n++] = ch;
		}
	}
}

K_THREAD_DEFINE(cfg_rx, 2048, rx_thread, NULL, NULL, NULL, 7, 0, 0);
```

## src/cfg.h
```c
#pragma once
/* Sürüm (main.c ve cfg.c ortak) */
#define FW_VERSION "0.9.10"
```

## src/engine.h
```c
/*
 * Eşleme motoru: ayar ekranından gelen profile göre pad durumunu
 * klavye / fare / gamepad raporlarına çevirir.
 *
 * Ayar biçimi (küçük uçlu, ayar ekranı bunu üretir):
 *  Başlık 16 bayt:
 *   'P' 'M' sürüm(2) açılış(0=eşleme açık,1=gamepad) kombA kombB tutma_ms(u16)
 *   bayraklar(b0=profil geçişi açık, b1=atanmamış gamepad'e geçsin) profil_sayısı seçili
 *   profil_değiştirici profil_önceki profil_sonraki boş boş
 *  Her profil:
 *   çıkış(0 kb+fare,1 kb,2 pad,3 hepsi) tetik_eşik(%) uzun_ms(u16) çift_ms(u16)
 *   4 katman x 2 çubuk (sol, sağ) x 7 bayt: mod hız ölü% yukarı aşağı sol sağ (HID kodu)
 *     mod: 0 ana gibi, 1 kapalı, 2 fare, 3 tuşlar, 4 tekerlek, 5 gamepad
 *   atama_sayısı(u16), sonra her atama:
 *     katman tuş tetik diğer tür tekrar döngü_ms(u16) hedef_katman nasıl adım_sayısı
 *       tetik: 0 tek, 1 çift, 2 uzun, 3 basma anı, 4 bırakma, 5 birlikte (diğer = öbür tuş)
 *       tür: 0 tuş dizisi, 1 katman değiştir   tekrar: 0 normal, 1 turbo, 2 toggle, 3 makro (bir kez)
 *       nasıl: 0 basılıyken, 1 bas aç/bas kapat
 *     her adım 5 bayt: tip(0 klavye,1 fare,2 pad,3 medya) kod hareket(0 bas-bırak,1 basılı tut,2 bırak) sonra_ms(u16)
 */
#pragma once
#include <stdint.h>
#include <stdbool.h>
#include <stddef.h>
#include "pad.h"

#define CFG_MAX 8192
#define NBTN 22 /* pad.h düğmeleri + M1, M2 */

struct out_rep {
	uint8_t kb[8];
	uint8_t ms[4];
	uint8_t g[9];
	uint8_t cc[2]; /* medya tuşu (Consumer usage, küçük uçlu) */
};

enum eng_mode { E_PAD, E_MAP, E_LEGACY };

/* Ayarı denetle (0 = geçerli) */
int engine_check(const uint8_t *b, size_t len);
/* Ayarı kullanmaya başla; b bellekte kalmalı */
int engine_set_config(const uint8_t *b, size_t len);
bool engine_has_config(void);
/* Her 8 ms'de bir */
enum eng_mode engine_tick(const struct pad_state *p, int64_t now, struct out_rep *r);
bool engine_mapping(void);
void engine_set_mapping(bool on);
int engine_select_profile(int n);
int engine_profile(void);
int engine_profile_count(void);
int engine_active_layer(void);
/* Profil kartın üzerinden değişince (kaydetmek için) */
extern void engine_profile_changed(int n);
```

## src/hid_in.h
```c
/* Bluetooth klavye ve fare girişi (pad'in yanında, en fazla 2 cihaz) */
#pragma once
#include <stdbool.h>
#include <zephyr/bluetooth/conn.h>
#include "hid_map.h"

void hid_in_init(void);
/* bu bağlantı klavye/fare bağlantısı mı (pad değil) */
bool hid_in_is(struct bt_conn *c);
/* kayıtlı klavye/fare adresi mi */
bool hid_in_known(const bt_addr_le_t *a);
/* bağlanmayı bekleyen kayıtlı cihaz var mı (tarama sürsün) */
bool hid_in_need_scan(void);
/* taramada görülen cihaza bağlanılacak mı; bağlanma başlatıldıysa true */
bool hid_in_try(const bt_addr_le_t *a, const char *name);
/* adres filtresine eklemek için */
int hid_in_addrs(bt_addr_le_t *out, int max);
/* çıkış iş parçacığı: güncel giriş */
void hid_in_get(struct hid_in *o);
const struct hid_cfg *hid_in_cfg(void);
bool hid_in_active(void);
/* komutlar: hid ... */
bool hid_cmd(char *l);
```

## src/hid_map.c
```c
#include <string.h>
#include <math.h>
#include "hid_map.h"

void hid_cfg_default(struct hid_cfg *c)
{
	/* nişancı oyunları için alışılmış düzen */
	static const uint8_t def[][2] = {
		{ 0x1a, HT_LS + 0 }, { 0x16, HT_LS + 1 }, { 0x04, HT_LS + 2 }, { 0x07, HT_LS + 3 }, /* W S A D */
		{ 0x2c, PB_A }, { 0xe0, PB_B }, { 0x15, PB_X }, { 0x08, PB_Y },                       /* Boşluk, Ctrl, R, E */
		{ 0x14, PB_LB }, { 0x09, PB_RB }, { 0xe1, PB_L3 }, { 0x19, PB_R3 },                   /* Q F Shift V */
		{ 0x2b, PB_SELECT }, { 0x29, PB_START }, { 0x0b, PB_HOME },                            /* Tab Esc H */
		{ 0x1e, PB_UP }, { 0x1f, PB_RIGHT }, { 0x20, PB_DOWN }, { 0x21, PB_LEFT },            /* 1 2 3 4 */
		{ HK_MOUSE + 0, PB_RT }, { HK_MOUSE + 1, PB_LT }, { HK_MOUSE + 2, PB_R3 },
		{ HK_MOUSE + 3, PB_LB }, { HK_MOUSE + 4, PB_RB },
	};
	memset(c, 0, sizeof(*c));
	c->mode = 0;
	c->sens = 40;
	c->n = sizeof(def) / 2;
	memcpy(c->map, def, sizeof(def));
}

static int target_of(const struct hid_cfg *c, uint8_t code)
{
	for (int i = 0; i < c->n; i++) if (c->map[i][0] == code) return c->map[i][1];
	return -1;
}

static uint8_t hat_of(uint32_t b)
{
	bool u = b & (1u << PB_UP), d = b & (1u << PB_DOWN), l = b & (1u << PB_LEFT), r = b & (1u << PB_RIGHT);

	if (u && r) return 1;
	if (d && r) return 3;
	if (d && l) return 5;
	if (u && l) return 7;
	if (u) return 0;
	if (r) return 2;
	if (d) return 4;
	if (l) return 6;
	return 8;
}

static uint8_t clamp8(int v) { return v < 0 ? 0 : v > 255 ? 255 : v; }

void hid_to_pad(const struct hid_cfg *c, const struct hid_in *in, struct pad_state *p, uint8_t rest_kb[8], uint8_t *rest_mbtn)
{
	uint32_t btn = 0;
	int ls[4] = { 0 }, rs[4] = { 0 };
	int nrest = 2;

	memset(rest_kb, 0, 8);
	*rest_mbtn = 0;

	/* basılı kaynak kodları: değiştiriciler (E0..E7), tuşlar, fare tuşları */
	uint8_t codes[8 + 6 + 5];
	int nc = 0;

	for (int i = 0; i < 8; i++) if (in->kb[0] & (1 << i)) codes[nc++] = 0xe0 + i;
	for (int i = 2; i < 8; i++) if (in->kb[i] > 3) codes[nc++] = in->kb[i];
	for (int i = 0; i < 5; i++) if (in->mbtn & (1 << i)) codes[nc++] = HK_MOUSE + i;

	for (int i = 0; i < nc; i++) {
		uint8_t k = codes[i];
		int t = target_of(c, k);

		if (t < 0 || t >= HT_COUNT) {
			/* atanmamış: olduğu gibi klavye/fare olarak geçsin */
			if (k >= HK_MOUSE) *rest_mbtn |= 1 << (k - HK_MOUSE);
			else if (k >= 0xe0) rest_kb[0] |= 1 << (k - 0xe0);
			else if (nrest < 8) rest_kb[nrest++] = k;
			continue;
		}
		if (t < HT_LS) btn |= 1u << t;
		else if (t < HT_RS) ls[t - HT_LS] = 1;
		else rs[t - HT_RS] = 1;
	}

	if (!p->valid) {
		p->btn = 0;
		p->lx = p->ly = p->rx = p->ry = 128;
		p->lt = p->rt = 0;
		p->hat = 8;
		p->valid = true;
	}
	p->btn |= btn;
	if (btn & (1u << PB_LT)) p->lt = 255;
	if (btn & (1u << PB_RT)) p->rt = 255;
	if (btn & ((1u << PB_UP) | (1u << PB_DOWN) | (1u << PB_LEFT) | (1u << PB_RIGHT))) p->hat = hat_of(p->btn);

	/* tuşlarla sol/sağ çubuk (karşılıklı basılıysa ortada kalır) */
	if (ls[0] || ls[1]) p->ly = ls[0] && !ls[1] ? 0 : ls[1] && !ls[0] ? 255 : 128;
	if (ls[2] || ls[3]) p->lx = ls[2] && !ls[3] ? 0 : ls[3] && !ls[2] ? 255 : 128;
	if (rs[0] || rs[1]) p->ry = rs[0] && !rs[1] ? 0 : rs[1] && !rs[0] ? 255 : 128;
	if (rs[2] || rs[3]) p->rx = rs[2] && !rs[3] ? 0 : rs[3] && !rs[2] ? 255 : 128;

	/* fare hareketi → sağ çubuk. Oyunların ölü bölgesini aşmak için küçük hareket de en az %20 iter. */
	if (in->vx || in->vy) {
		float fx = in->vx / 16.0f * c->sens * 1.6f, fy = in->vy / 16.0f * c->sens * 1.6f;
		float m = sqrtf(fx * fx + fy * fy);

		if (m > 0.5f) {
			float m2 = 26 + m * (127 - 26) / 127;

			if (m2 > 127) m2 = 127;
			fx = fx / m * m2;
			fy = fy / m * m2;
			p->rx = clamp8(128 + (int)lrintf(fx));
			p->ry = clamp8(128 + (int)lrintf(fy));
		}
	}
}

static int8_t add8(int a, int b)
{
	int v = a + b;

	return v > 127 ? 127 : v < -127 ? -127 : v;
}

void hid_merge_out(const uint8_t kb[8], uint8_t mbtn, int dx, int dy, int wh, struct out_rep *r)
{
	r->kb[0] |= kb[0];
	for (int i = 2; i < 8; i++) {
		uint8_t k = kb[i];
		bool have = false;
		int fr = -1;

		if (k <= 3) continue;
		for (int j = 2; j < 8; j++) {
			if (r->kb[j] == k) have = true;
			if (!r->kb[j] && fr < 0) fr = j;
		}
		if (!have && fr >= 0) r->kb[fr] = k;
	}
	r->ms[0] |= mbtn & 0x1f;
	r->ms[1] = add8((int8_t)r->ms[1], dx);
	r->ms[2] = add8((int8_t)r->ms[2], dy);
	r->ms[3] = add8((int8_t)r->ms[3], wh);
}
```
